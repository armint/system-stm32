# STM32WL5x_CM0P register map
File version: 1.5
CPU: CM0 r0p1, little endian, MPU, no FPU, 4 interrupt priority bits
Registers are 32-bit, read-write, reset 0x0 unless marked. A register's access mark holds for its fields unless they carry their own. Offsets are from the block's base; lines under a group give offsets from that group; [hi:lo] are bit positions; {n}, {i} and the like mark numbered series; 'fields as' and 'values as' point back to an identical list; <NAME> marks a mode.

## Memory map
0x40000000 TIM2 size 0x400 — General-purpose-timers
0x40002800 RTC size 0x400 — Real-time clock
0x40002C00 WWDG size 0x400 — System window watchdog
0x40003000 IWDG size 0x400 — Independent watchdog
0x40003800 SPI2 size 0x400
0x40004400 USART2 size 0x400
0x40005400 I2C1 size 0x400 — Inter-integrated circuit
0x40005800 I2C2 size 0x400
0x40005C00 I2C3 size 0x400
0x40007400 DAC1 size 0x400 — Digital-to-analog converter
0x40007C00 LPTIM1 size 0x400 — Low-power timer
0x40008000 LPUART size 0x400 — Universal synchronous asynchronous receiver transmitter
0x40009400 LPTIM2 size 0x400 — Low-power timer
0x40009800 LPTIM3 size 0x400 — Low-power timer
0x4000B000 TAMP size 0x400 — Tamper and backup registers
0x40010000 SYSCFG size 0x30 — System configuration controller
0x40010030 VREFBUF size 0xD0 — Voltage reference buffer
0x40010100 SYSCFG_continue size 0x100 — System configuration controller
0x40010200 COMP size 0x200 — Comparator
0x40012400 ADC size 0x400 — Analog to digital convertor
0x40012C00 TIM1 size 0x400 — Advanced-control timers
0x40013000 SPI1 size 0x400 — Serial peripheral interface/Inter-IC sound
0x40013800 USART1 size 0x400 — Universal synchronous asynchronous receiver transmitter
0x40014400 TIM16 size 0x400 — General-purpose timers
0x40014800 TIM17 size 0x400 — General-purpose timers
0x40020000 DMA1 size 0x400 — Direct memory access controller
0x40020400 DMA2 size 0x400
0x40020800 DMAMUX size 0x400 — DMA request multiplexer
0x40023000 CRC size 0x400 — Cyclic redundancy check calculation unit
0x48000000 GPIOA size 0x400 — General-purpose I/Os
0x48000400 GPIOB size 0x400 — General-purpose I/Os
0x48000800 GPIOC size 0x400 — General-purpose I/Os
0x48001C00 GPIOH size 0x400 — General-purpose I/Os
0x58000000 RCC size 0x400 — Reset and clock control
0x58000400 PWR size 0x400 — Power control
0x58000800 EXTI size 0x400 — External interrupt/event controller
0x58000C00 IPCC size 0x400 — Inter Processor communication controller
0x58001000 RNG size 0x400 — True random number generator
0x58001400 HSEM size 0x400 — Hardware semaphore
0x58001800 AES size 0x400 — Advanced encryption standard hardware accelerator 1
0x58002000 PKA size 0x2000 — Public key accelerator
0x58004000 FLASH size 0x400
0x58004400 TZSC size 0x400 — Global TrustZone Controller
0x58004800 TZIC size 0x400 — TrustZone Interrupt Control
0x58010000 SPI3 size 0x400
0xE000E008 SCB_ACTRL size 0x5 — System control block ACTLR
0xE000E010 STK size 0x11 — SysTick timer
0xE000E100 NVIC size 0x355 — Nested Vectored Interrupt Controller
0xE000ED00 SCB size 0x41 — System control block
0xE000ED90 MPU size 0x15 — Memory protection unit
0xE000EF00 NVIC_STIR size 0x5 — Nested vectored interrupt controller
0xE0042000 DBGMCU size 0x400 — Microcontroller Debug Unit

## Interrupts
0 TZIC_ILA (TZIC) — Security Interrupt controller illegal access interrupt
1 PVD (EXTI) — PVD through EXTI
2 RTC_STAMP (RTC) — RTC Tamper, TimeStamp, LSECSS interrupt through (C2IMR1[0])
3 RCC — RCC global interrupt
4 EXTI1_0 (EXTI) — EXTI line 0 interrupt through EXTI
5 EXTI3_2 (EXTI) — EXTI line 1 interrupt through EXTI
6 EXTI15_4 (EXTI) — EXTI line 2 interrupt through EXTI
7 ADC1 (ADC) — ADC1 global interrupt
8 DMA1_Channel1 (DMA1) — DMA1 Channel1 global interrupt
9 DMA1_Channel4 (DMA1) — DMA1 Channel4 global interrupt
10 DMA2_CH7 (DMA2) — DMA2 channel 7 interrupt
11 LPTIM1 — LPtimer 1 global interrupt
12 LPTIM2 — LPtimer 2 global interrupt
13 LPTIM3 — LPtimer 3 global interrupt
14 TIM1 — Timer 1 break, update, trigger and communication,
15 TIM2 — TIM2 global interrupt
16 TIM16 — Timer 16 global interrupt
17 TIM17 — Timer 17 global interrupt
18 IPCC_C1_RX_IT (IPCC) — IPCC CPU1 RX occupied interrupt
19 HSEM — Semaphore interrupt 0 to CPU1
20 True_RNG (RNG) — True random number generator interrupt
21 AES — AES global interrupt
22 I2C1_EV (I2C1) — I2C1 event interrupt
23 I2C2_EV (I2C2) — I2C2 error interrupt
24 I2C3_EV (I2C3) — I2C3 event interrupt
25 SPI1 — SPI 1 global interrupt
26 SPI2S2 (SPI2) — SPI2S2 global interrupt
27 USART1 — USART1 global interrupt
28 USART2 — USART2 global interrupt
29 LPUART1 (LPUART) — LPUART1 global interrupt
30 SPI3 — SPI3 global interrupt
31 Radio_IRQ_Busy (EXTI) — Radio IRQs RFBUSY interrupt through EXTI
